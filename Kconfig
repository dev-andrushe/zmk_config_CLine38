## Kconfig
```kconfig
config CLINE38_MIXED_SCROLL
    bool "CLine38 mixed vertical scroll and horizontal gestures"
    default y
    depends on DT_HAS_ZMK_INPUT_PROCESSOR_MIXED_SCROLL_ENABLED
    depends on ZMK_INPUT_PROCESSOR_LAYER_ROUTER
    depends on !ZMK_SPLIT || ZMK_SPLIT_ROLE_CENTRAL

config CLINE38_RETRO_POINTER
    bool "Resolve Retro Tap holds with physical trackball motion"
    default y
    depends on DT_HAS_PIXART_PMW3610_ALT_ENABLED
    depends on ZMK_BEHAVIOR_HOLD_TAP && ZMK_INPUT_LISTENER
    depends on !ZMK_SPLIT || ZMK_SPLIT_ROLE_CENTRAL

config CLINE38_RETRO_POINTER_THRESHOLD
    int "Raw movement counts required to resolve a Retro Tap hold"
    default 8
    range 1 32767
    depends on CLINE38_RETRO_POINTER

config CLINE38_RETRO_POINTER_IDLE_MS
    int "Discard sub-threshold motion after this idle time"
    default 150
    range 1 1000
    depends on CLINE38_RETRO_POINTER
```

## config/west.yml
```yaml
manifest:
  remotes:
    - name: cormoran
      url-base: https://github.com/cormoran
    - name: badjeff    # <-- PMW3610
      url-base: https://github.com/badjeff
    - name: caksoylar  # <-- RGB LED
      url-base: https://github.com/caksoylar
    - name: takamaru-fpv  # <-- Battery level smoothing
      url-base: https://github.com/takamaru-fpv
    - name: kot149
      url-base: https://github.com/kot149
    - name: jpttm
      url-base: https://github.com/jpttm

    - name: mjmjm0101
      url-base: https://github.com/mjmjm0101

  projects:
    # ZMK: DYA Studio 用カスタム RPC サブシステム付き cormoran fork
    - name: zmk
      remote: cormoran
      # main+dya branch @ 2026-07-25 (Zephyr v4.1.0+zmk-fixes)
      revision: e5c9b6915b56801193e359dd9bad4a167ce0d1b8
      import: app/west.yml

    - name: zmk-module-ble-management
      remote: cormoran
      # main @ 2026-07-05 (zmk-v0.4.0.0 tag not published yet for this module)
      revision: 57738cc4fc6ba80e82a7ac57741a0339cb186cd4
    - name: zmk-module-battery-history
      remote: cormoran
      # main @ 2026-02-24 (no tags published for this module)
      revision: 307755dd2ad4d320e14de162e8e5ef018f29d929
    - name: zmk-module-settings-rpc
      remote: cormoran
      # main @ 2026-07-06 (zmk-v0.4.0.0 tag not published yet for this module)
      revision: 78f86df9e6c5edaf57bef3ccbd7f360cfdf49291
    - name: zmk-module-runtime-input-processor
      remote: cormoran
      revision: zmk-v0.4.0.0
    - name: zmk-behavior-runtime-sensor-rotate
      remote: cormoran
      # main @ 2026-07-05 (zmk-v0.4.0.0 tag not published yet for this module)
      revision: 8b1125ed676c1f5e14145d217984f33d0ebdcef4

    - name: zmk-feature-device-info
      remote: cormoran
      revision: 8cedd2dd9f04e19ea5a17b94914dd47a09d8db11
    - name: zmk-feature-runtime-combo
      remote: cormoran
      revision: d9490e7b5d41c516221d131241009e81740efcee
      import: true
    - name: zmk-feature-runtime-macro
      remote: cormoran
      revision: 38530962eb7061b60efcb98e84585cfb1f0cb6de
      import: true
    - name: zmk-feature-watchdog
      remote: cormoran
      revision: 84ad14c6c3645dc40b23f45d08ab45418655f912
    - name: zmk-feature-kscan-diagnostics
      remote: cormoran
      revision: 1432f7fe0cfe903cd7d3c9931ae6bd6f2e1f328e
    - name: zmk-feature-default-layer
      remote: cormoran
      revision: 92728246f80d327709839b2dbf5cf11880ff87e1
    - name: zmk-feature-fast-keymap
      remote: cormoran
      revision: 8dac76de0ba38588ba39ca498910e24f8332bc6b
    - name: zmk-feature-input-stream
      remote: cormoran
      revision: aeb015908a42a7615ccdccc7feb3a10d23132a71
    - name: zmk-feature-module-physical-layout
      remote: cormoran
      revision: 4f18de45dc27820725d267916b4cdacc0e0b6cf9

    # ころころKit: 認識 / レイヤー振り分け / 動作の保存・Studio RPC
    # 検証対象のコミットに固定 (2026-10-17)。ZMK/DYA 本体の版は維持する。
    - name: zmk-mouse-gesture
      remote: kot149
      # v1
      revision: a3f70a2a189f6fa34a0b696dea50b73368ce5750
    - name: zmk-input-processor-layer-router
      remote: jpttm
      revision: e1644b4170833905b0d8ce27194dba0350aeb972
    - name: zmk-feature-gesture-action
      remote: jpttm
      revision: cb69e5b1009987051cf1774344d36ee20e758e94

    # 慣性スクロール (右側の標準版のみ)
    - name: zmk-input-processor-scroll-inertia
      remote: mjmjm0101
      revision: f7dadefee453d555fe066d13a3de3bb60739b45e

    #その他のモジュール
    - name: zmk-pmw3610-driver
      remote: badjeff
      revision: main
    - name: zmk-rgbled-widget
      remote: caksoylar
      revision: main
    - name: zmk-feature-non-lipo-battery-management
      remote: takamaru-fpv
      revision: voltage_division
  self:
    path: config
```

## dts/bindings/behaviors/cline38,behavior-ctrl-layer8.yaml
```yaml
description: Source-owned Ctrl and momentary layer 8 for the dedicated Hold-Tap
compatible: "cline38,behavior-ctrl-layer8"
include: one_param.yaml
```

## dts/bindings/input-processors/zmk,input-processor-mixed-scroll.yaml
```yaml
description: CLine38 continuous vertical scrolling with horizontal gesture action slots
compatible: "zmk,input-processor-mixed-scroll"

properties:
  "#input-processor-cells":
    type: int
    const: 0
  track-remainders:
    type: boolean
  route-index:
    type: int
    required: true
    description: Zero-based layer-router route whose runtime layer mask enables this mode
  bindings:
    type: phandle-array
    required: true
    description: Left and right behaviors, in that order
  scroll-reference:
    type: phandle
    required: true
    description: Layer 3 runtime processor whose persistent scale and Y inversion are used
  direction-threshold:
    type: int
    default: 8
  gesture-threshold:
    type: int
    default: 100
  diagonal-threshold:
    type: int
    default: 24
  idle-ms:
    type: int
    default: 250
```

## dts/bindings/input-processors/zmk,input-processor-slow-zoom.yaml
```yaml
description: Rate-limited Ctrl-wheel zoom, with editable left and right gesture action slots
compatible: "zmk,input-processor-slow-zoom"

properties:
  "#input-processor-cells":
    type: int
    const: 0
  track-remainders:
    type: boolean
  layer:
    type: int
    required: true
  bindings:
    type: phandle-array
    required: true
    description: Left and right behaviors (gesture_action slots 6 and 7), in that order
  counts-per-step:
    type: int
    default: 64
  min-interval-ms:
    type: int
    default: 200
  ctrl-settle-ms:
    type: int
    default: 40
```
